## conf/layer.conf
```bitbake
# We have a conf and classes directory, add to BBPATH
BBPATH := "${BBPATH}:${LAYERDIR}"

# We have a recipes directory, add to BBFILES
BBFILES := "${BBFILES} ${LAYERDIR}/recipes-*/*/*.bb \
	${LAYERDIR}/recipes-*/*/*.bbappend"

BBFILE_COLLECTIONS += "meta-mediaserver"
BBFILE_PATTERN_meta-mediaserver := "^${LAYERDIR}/"
BBFILE_PRIORITY_meta-mediaserver = "7"

LAYERDEPENDS_meta-mediaserver = "openembedded-layer networking-layer"
LAYERSERIES_COMPAT_meta-mediaserver = "zeus dunfell"
```
